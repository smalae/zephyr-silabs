## drivers/pwm/Kconfig
```kconfig
# Copyright (c) 2025 Silicon Laboratories Inc.
# SPDX-License-Identifier: Apache-2.0

if PWM

rsource "Kconfig.siwx917"

endif
```

## drivers/pwm/Kconfig.siwx917
```kconfig
# Copyright (c) 2025 Silicon Laboratories Inc.
# SPDX-License-Identifier: Apache-2.0

config PWM_SILABS_SIWX917
	bool "Silabs SiWx917 PWM driver"
	default y
	depends on DT_HAS_SILABS_SIWX917_PWM_ENABLED
	help
	  Enable the PWM driver for the Silabs SiWx917 SoC series.
```

## drivers/watchdog/Kconfig.siwx917
```kconfig
# Copyright (c) 2024 Silicon Laboratories Inc.
# SPDX-License-Identifier: Apache-2.0

menuconfig WATCHDOG_SILABS_SIWX917
	bool "Silabs SiWx917 Watchdog driver"
	default y
	depends on DT_HAS_SILABS_SIWX917_WATCHDOG_ENABLED
	help
	  Enable the Watchdog driver for the Silabs SiWx917 SoC series.

config WDT_SIWX917_COMMON_INIT_PRIORITY
	int "Common initialization priority"
	depends on WATCHDOG_SILABS_SIWX917
	default 42
```

## dts/bindings/pwm/silabs,siwx917-pwm.yaml
```yaml
description: |
  Silabs Siwx917 PWM Controller

  The Siwx917 PWM controller is designed to generate PWM signals. The mapping
  between PWM channels and GPIO pins is configured through pinctrl settings.

  Example pinctrl configuration for two PWM channels,
  &pinctrl0 {
      pwm_ch1: pwm_ch1 {
          pinmux = <PWM_1H_PA7>, <PWM_1L_PA6>;
      };
      pwm_ch2: pwm_ch2 {
          pinmux = <PWM_2H_PA9>, <PWM_2L_PA8>;
      };
  };

  The property silabs,channel-count defines the number of PWM channels.
  Below is an example overlay configuration,
  &pwm {
      silabs,channel-count = <2>;
      pinctrl-0 = <&pwm_ch1>, <&pwm_ch2>;
      pinctrl-names = "default";
      pwm_channel1: pwm_channel1 {
          pwms = <&pwm 0 1000000>;    // Channel 0, 1ms period (1000000 ns)
      };
      pwm_channel2: pwm_channel2 {
          pwms = <&pwm 1 2000000>;    // Channel 1, 2ms period (2000000 ns)
      };
      status = "okay";
  };
  This configuration enables two PWM channels, with each channel's signal period specified in nanoseconds.

compatible: "silabs,siwx917-pwm"

include: [base.yaml, pinctrl-device.yaml, pwm-controller.yaml]

properties:
  silabs,channel-count:
    type: int
    required: true
    description: |
        Number of PWM channels configured

  "#pwm-cells":
    const: 2

pwm-cells:
  - channel
  - period
```

## dts/bindings/watchdog/silabs,siwx917-watchdog.yaml
```yaml
description: Silabs SiWx917 Watchdog node

compatible: "silabs,siwx917-watchdog"

include: base.yaml

properties:
  reg:
    required: true

  interrupts:
    required: true

  silabs,fsm-clock:
    type: int
    description: FSM clock source id
    required: true
    
  silabs,bg-pmu-clock:
    type: int
    description: BG-PMU clock source id
    required: true
```
