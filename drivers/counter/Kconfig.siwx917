## drivers/counter/Kconfig.siwx917
```kconfig
# Copyright (c) 2024 Silicon Laboratories Inc.
# SPDX-License-Identifier: Apache-2.0

menuconfig COUNTER_SILABS_SIWX917
	bool "Silabs SiWx917 Counter driver"
	default y
	depends on DT_HAS_SILABS_SIWX917_COUNTER_ENABLED
	help
	  Enable the Counter driver for Siwx917

config COUNTER_SILABS_SIWX917_COMMON_INIT_PRIORITY
	int "Common initialization priority"
	depends on COUNTER_SILABS_SIWX917
	default 42
```

## dts/bindings/counter/silabs,siwx917-counter.yaml
```yaml
description: siwg917 counters

compatible: "silabs,siwx917-counter"

include: base.yaml

properties:
  frequency:
    type: int
    required: true
    description: |
        Timer module clock source frequency
```

## dts/bindings/dma/silabs,siwx917-dma.yaml
```yaml
description: Silabs SiWx917 DMA node

compatible: "silabs,siwx917-dma"

include: dma-controller.yaml

properties:
  reg:
    required: true

  sram-desc-addr:
    type: int
    required: true
    description: SRAM address where UDMA descriptor is stored

  "#dma-cells":
    const: 1

# Parameter syntax
dma-cells:
  - channel
```
